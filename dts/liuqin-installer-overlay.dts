// SPDX-License-Identifier: GPL-2.0-only
/*
 * Installer-only USB role.
 *
 * The normal liuqin DT remains USB2 peripheral-only because that is the
 * validated ABL/fastboot hand-off.  The live installer uses the same USB2
 * peripheral role as the downstream first-boot image: its initramfs creates
 * a configfs NCM gadget and exposes a local control network to the host.
 * Keeping this in a separate overlay means the normal boot image does not
 * silently change its Type-C role.
 */
/dts-v1/;
/plugin/;

&usb_1 {
	status = "okay";
};

&usb_1 {
	dr_mode = "peripheral";
	maximum-speed = "high-speed";
	phys = <&usb_1_hsphy>;
	phy-names = "usb2-phy";
};

&usb_1_hsphy {
	status = "okay";
};
